## Kconfig
```kconfig
# CAN configuration options

# Copyright (c) 2018 Alexander Wachter
# SPDX-License-Identifier: Apache-2.0

#
# CAN options
#

menuconfig USER_CAN
	bool "Controller Area Network (CAN) drivers write by user"
	help
	  Enable CAN Driver Configuration

source "user_driver/can_custom_driver/Kconfig.stm32_custom"
```

## Kconfig.stm32_custom
```kconfig
# STM32 CAN configuration options

# Copyright (c) 2022 Blue Clover
# Copyright (c) 2018-2020 Alexander Wachter
# SPDX-License-Identifier: Apache-2.0

config CAN_STM32_CUSTOM
	bool "STM32 CAN driver custom"
	default y
	help
	  Enable STM32 CAN Driver custom.
```
